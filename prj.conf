## CMakeLists.txt
```
#

cmake_minimum_required(VERSION 3.20.0)

find_package(Zephyr REQUIRED HINTS $ENV{ZEPHYR_BASE})
project(aws_iot)

# NORDIC SDK APP START
target_sources(app PRIVATE src/main.c)
# NORDIC SDK APP END

zephyr_include_directories(src)
```

## Kconfig
```
menu "AWS IoT Sample Settings"

config APP_VERSION
	string "Application version"
	default "v1.0.0"

config PUBLICATION_INTERVAL_SECONDS
	int "Interval in seconds that the sample will publish data"
	default 60

config CONNECTION_RETRY_TIMEOUT_SECONDS
	int "Number of seconds between each AWS IoT connection retry"
	default 30

endmenu

menu "Zephyr Kernel"
source "Kconfig.zephyr"
endmenu
```

## sample.yaml
```
sample:
  name: AWS IoT sample
tests:
  samples.nrf9160.aws_iot:
    build_only: true
    platform_allow: nrf9160dk_nrf9160_ns thingy91_nrf9160_ns
    integration_platforms:
      - nrf9160dk_nrf9160_ns
      - thingy91_nrf9160_ns
    tags: ci_build
```

## prj.conf
```kconfig
# General config
CONFIG_NCS_SAMPLES_DEFAULTS=y
CONFIG_REBOOT=y

# NEWLIB C
CONFIG_NEWLIB_LIBC=y
CONFIG_NEWLIB_LIBC_FLOAT_PRINTF=y

# Network
CONFIG_NETWORKING=y
CONFIG_NET_NATIVE=n

# LTE link control
CONFIG_LTE_LINK_CONTROL=y
CONFIG_LTE_NETWORK_MODE_LTE_M=y
CONFIG_LTE_AUTO_INIT_AND_CONNECT=n

# Modem library
CONFIG_NRF_MODEM_LIB=y

# AT Host
CONFIG_UART_INTERRUPT_DRIVEN=y
CONFIG_AT_HOST_LIBRARY=y

# AWS IoT library
CONFIG_AWS_IOT=y
CONFIG_AWS_IOT_CLIENT_ID_STATIC="test1"
CONFIG_AWS_IOT_BROKER_HOST_NAME="a10lrrmt9cmd0k-ats.iot.eu-north-1.amazonaws.com"
CONFIG_AWS_IOT_SEC_TAG=201
CONFIG_AWS_IOT_APP_SUBSCRIPTION_LIST_COUNT=2
CONFIG_AWS_IOT_TOPIC_UPDATE_DELTA_SUBSCRIBE=y
CONFIG_AWS_IOT_LAST_WILL=y
CONFIG_AWS_IOT_TOPIC_GET_ACCEPTED_SUBSCRIBE=y
CONFIG_AWS_IOT_TOPIC_GET_REJECTED_SUBSCRIBE=y

# MQTT - Maximum MQTT keepalive timeout specified by AWS IoT Core
CONFIG_MQTT_KEEPALIVE=1200

# Date Time library
CONFIG_DATE_TIME=y

# Modem information
CONFIG_MODEM_INFO=y

# Heap and stacks
CONFIG_HEAP_MEM_POOL_SIZE=8192
CONFIG_MAIN_STACK_SIZE=4096
CONFIG_SYSTEM_WORKQUEUE_STACK_SIZE=2048

# MCUBOOT
CONFIG_BOOTLOADER_MCUBOOT=y
CONFIG_MCUBOOT_IMG_MANAGER=y

# Image manager
CONFIG_IMG_MANAGER=y
CONFIG_FLASH=y
CONFIG_IMG_ERASE_PROGRESSIVELY=y

# AWS FOTA
CONFIG_AWS_FOTA=y
CONFIG_FOTA_DOWNLOAD=y
CONFIG_DFU_TARGET=y

# CJSON
CONFIG_CJSON_LIB=y

# Download client (needed by AWS FOTA)
CONFIG_DOWNLOAD_CLIENT=y
CONFIG_DOWNLOAD_CLIENT_STACK_SIZE=4096


CONFIG_GPIO=y
```

## prj_qemu_x86.conf
```kconfig
# General config
CONFIG_NCS_SAMPLES_DEFAULTS=y
CONFIG_REBOOT=y
CONFIG_FPU=y

# NEWLIB C
CONFIG_NEWLIB_LIBC=y
CONFIG_NEWLIB_LIBC_FLOAT_PRINTF=y

# Date Time library
CONFIG_DATE_TIME=y
CONFIG_DATE_TIME_MODEM=n

# AWS IoT library
CONFIG_AWS_IOT=y
CONFIG_AWS_IOT_CLIENT_ID_STATIC="test1"
CONFIG_AWS_IOT_BROKER_HOST_NAME="a10lrrmt9cmd0k-ats.iot.eu-north-1.amazonaws.com"
CONFIG_AWS_IOT_SEC_TAG=201
CONFIG_AWS_IOT_APP_SUBSCRIPTION_LIST_COUNT=2
CONFIG_AWS_IOT_TOPIC_UPDATE_DELTA_SUBSCRIBE=y

CONFIG_NET_SOCKETS_SOCKOPT_TLS=y

# TLS configuration
CONFIG_MBEDTLS=y
CONFIG_MBEDTLS_BUILTIN=y
CONFIG_MBEDTLS_ENABLE_HEAP=y
CONFIG_MBEDTLS_HEAP_SIZE=120000
CONFIG_MBEDTLS_SSL_MAX_CONTENT_LEN=16384
CONFIG_MBEDTLS_PEM_CERTIFICATE_FORMAT=y
CONFIG_MBEDTLS_KEY_EXCHANGE_RSA_ENABLED=y
CONFIG_MBEDTLS_MAC_SHA256_ENABLED=y

CONFIG_NET_SOCKETS_SOCKOPT_TLS=y

# Networking config
CONFIG_NETWORKING=y
CONFIG_NET_IPV4=y
CONFIG_NET_TCP=y
CONFIG_NET_SOCKETS=y
CONFIG_NET_SOCKETS_POSIX_NAMES=y

CONFIG_DNS_RESOLVER=y
CONFIG_DNS_SERVER_IP_ADDRESSES=y
CONFIG_DNS_SERVER1="8.8.8.8"

# Network address config
CONFIG_NET_CONFIG_SETTINGS=y
CONFIG_NET_CONFIG_NEED_IPV4=y
CONFIG_NET_CONFIG_MY_IPV4_ADDR="192.0.2.1"
CONFIG_NET_CONFIG_MY_IPV4_GW="192.0.2.2"

# Heap and stacks
CONFIG_HEAP_MEM_POOL_SIZE=4096
CONFIG_MAIN_STACK_SIZE=4096
CONFIG_SYSTEM_WORKQUEUE_STACK_SIZE=2048

# CJSON
CONFIG_CJSON_LIB=y
```

## nrf9160_pca10090.overlay
```dts
&led0 {
    gpios = <&gpio0 3 GPIO_INT_ACTIVE_LOW>;
    status = "enabled";
};

&adc {
	status = "ok";
};
```

## src/main.c
```c
#include <zephyr.h>
#include <stdio.h>
#include <stdlib.h>
#if defined(CONFIG_NRF_MODEM_LIB)
#include <modem/lte_lc.h>
#include <modem/nrf_modem_lib.h>
#include <modem/at_cmd.h>
#include <modem/at_notif.h>
#include <modem/modem_info.h>
#include <nrf_modem.h>
#endif
#include <net/aws_iot.h>
#include <sys/reboot.h>
#include <date_time.h>
#include <dfu/mcuboot.h>
#include <cJSON.h>
#include <cJSON_os.h>

#include <timing/timing.h>

#include <drivers/gpio.h>
#include <device.h>

/*
#define CONFIG_AWS_IOT_BROKER_HOST_NAME "a10lrrmt9cmd0k-ats.iot.eu-north-1.amazonaws.com"
#define CONFIG_AWS_IOT_SEC_TAG "" //default
#define CONFIG_AWS_IOT_CLIENT_ID_STATIC "test1"  
set in prj.conf */

#define LED 3
const struct device *dev_led;

static int json_add_obj(cJSON *parent, const char *str, cJSON *item)
{
	cJSON_AddItemToObject(parent, str, item);

	return 0;
}


static int json_add_str(cJSON *parent, const char *str, const char *item)
{
	cJSON *json_str;

	json_str = cJSON_CreateString(item);
	if (json_str == NULL) {
		return -ENOMEM;
	}

	return json_add_obj(parent, str, json_str);
}

static int json_add_number(cJSON *parent, const char *str, double item)
{
	cJSON *json_num;

	json_num = cJSON_CreateNumber(item);
	if (json_num == NULL) {
		return -ENOMEM;
	}

	return json_add_obj(parent, str, json_num);
}

static char topic_name[75]="general/nb/temperature";
//static size_t size_topic=strlen(topic_name);
struct aws_iot_topic_data generalNbTemperature = {
	.type = AWS_IOT_SHADOW_TOPIC_UNKNOWN,
	.str = topic_name,
	.len= 22 //number of characters in .str
};

static char topic_name_2[75]="general/nb/metering";
struct aws_iot_topic_data metering_topic = {
	.type = AWS_IOT_SHADOW_TOPIC_UNKNOWN,
	.str = topic_name_2,
	.len= 19 //number of characters in .str
};

static char topic_name_3[75]="general/nb/ping";
struct aws_iot_topic_data ping_topic = {
	.type = AWS_IOT_SHADOW_TOPIC_UNKNOWN,
	.str = topic_name_3,
	.len= 15 //number of characters in .str
};

void run_on_startup(){
	dev_led = device_get_binding("GPIO_0");
	gpio_pin_configure(dev_led, 2, GPIO_OUTPUT);
}

void led_off()
{
	printk("Initiating demand response \n");
	dev_led = device_get_binding("GPIO_0");
	gpio_pin_configure(dev_led, 2, GPIO_OUTPUT);
	gpio_pin_set(dev_led, 2, 0);
}

void led_on()
{
	printk("Ending demand response \n");
	dev_led = device_get_binding("GPIO_0");
	gpio_pin_configure(dev_led, 2, GPIO_OUTPUT);
	gpio_pin_set(dev_led, 2, 1);
}

float meter_dataset[24]={4.02, 1.6, 8.94, 6.93, 5.53, 5.04, 
						8.81, 8.10, 4.60, 9.79, 2.04, 8.27,
						2.47, 8.77, 1.68, 5.31, 1.57, 6.04,
						7.74, 1.20, 5.30, 8.67, 3.10, 5.85};

float get_metering_data(int hour){
	if(hour>=0 && hour<24){
		return meter_dataset[hour];
	}
	else{
		return 0;
	}
}


void run_metering(int day, int hour){
	printk("running metering \n");
	int err;

	float metering_data;
	// get metering data
	metering_data=get_metering_data(hour);


	//put data in json object
	cJSON *root_obj = cJSON_CreateObject();
	//temperature=round(temperature);
	json_add_str(root_obj, "id", CONFIG_AWS_IOT_CLIENT_ID_STATIC);
	json_add_number(root_obj, "day", day);
	json_add_number(root_obj, "hour", hour);
	json_add_number(root_obj, "metering_data", metering_data);
	char *message;
	message=cJSON_Print(root_obj);

	//send data to aws
	if (message == NULL) {
		printk("cJSON_Print, error: returned NULL\n");
		err = -ENOMEM;
	}
	struct aws_iot_data tx_data = {
		.qos = MQTT_QOS_0_AT_MOST_ONCE,
		.topic=metering_topic,
		.ptr = message,
		.len = strlen(message)
	};


	printk("Publishing: %s to AWS IoT broker\n", message);

	err = aws_iot_send(&tx_data);
	if (err) {
		printk("aws_iot_send, error: %d\n", err);
	}
	cJSON_FreeString(message);
	cJSON_Delete(root_obj);
}

void run_metering_2(){
	printk("running metering \n");
	int err;
	int day=2;
	float metering_data;
	// get metering data


	//put data in json object
	cJSON *root_obj = cJSON_CreateObject();
	//temperature=round(temperature);
	json_add_str(root_obj, "id", CONFIG_AWS_IOT_CLIENT_ID_STATIC);
	json_add_number(root_obj, "day", day);
	json_add_str(root_obj, "data", "3.50,8.80,4.50,6.80,2.20,5.60,2.60,3.90,5.20,3.00,9.70,6.00,6.50,9.40,9.00,8.00,8.10,8.50,2.90,6.20,7.10,4.10,5.90,9.3");
	char *message;
	message=cJSON_Print(root_obj);

	//send data to aws
	if (message == NULL) {
		printk("cJSON_Print, error: returned NULL\n");
		err = -ENOMEM;
	}
	struct aws_iot_data tx_data = {
		.qos = MQTT_QOS_0_AT_MOST_ONCE,
		.topic=metering_topic,
		.ptr = message,
		.len = strlen(message)
	};


	printk("Publishing: %s to AWS IoT broker\n", message);

	err = aws_iot_send(&tx_data);
	if (err) {
		printk("aws_iot_send, error: %d\n", err);
	}
	cJSON_FreeString(message);
	cJSON_Delete(root_obj);
}

void ping_response(){
	int err;

	cJSON *root_obj = cJSON_CreateObject();
	json_add_str(root_obj, "id", CONFIG_AWS_IOT_CLIENT_ID_STATIC);
	json_add_number(root_obj, "request_id", 22);

	char *message;
	message=cJSON_Print(root_obj);
	//send data to aws
	if (message == NULL) {
		printk("cJSON_Print, error: returned NULL\n");
		err = -ENOMEM;
	}
	struct aws_iot_data tx_data = {
		.qos = MQTT_QOS_0_AT_MOST_ONCE,
		.topic=ping_topic,
		.ptr = message,
		.len = strlen(message)
	};


	printk("Publishing: %s to AWS IoT broker\n", message);

	err = aws_iot_send(&tx_data);
	if (err) {
		printk("aws_iot_send, error: %d\n", err);
	}
	cJSON_FreeString(message);
	cJSON_Delete(root_obj);
}

static float read_voltage_sensor()
{
	int my_int=0;
	return 0.75;
}



BUILD_ASSERT(!IS_ENABLED(CONFIG_LTE_AUTO_INIT_AND_CONNECT),
		"This sample does not support LTE auto-init and connect");

#define APP_TOPICS_COUNT CONFIG_AWS_IOT_APP_SUBSCRIPTION_LIST_COUNT

static struct k_work_delayable shadow_update_work;
static struct k_work_delayable connect_work;
static struct k_work shadow_update_version_work;

static bool cloud_connected;

K_SEM_DEFINE(lte_connected, 0, 1);

static int shadow_update(bool version_number_include){
	int err=aws_iot_ping();
	return err;
}


static void connect_work_fn(struct k_work *work)
{
	int err;

	if (cloud_connected) {
		return;
	}

	err = aws_iot_connect(NULL);
	if (err) {
		printk("aws_iot_connect, error: %d\n", err);
	}

	printk("Next connection retry in %d seconds\n",
	       CONFIG_CONNECTION_RETRY_TIMEOUT_SECONDS);

	k_work_schedule(&connect_work,
			K_SECONDS(CONFIG_CONNECTION_RETRY_TIMEOUT_SECONDS));
}

static void shadow_update_work_fn(struct k_work *work)
{
	int err;

	if (!cloud_connected) {
		return;
	}

	err = shadow_update(false);
	if (err) {
		printk("shadow_update, error: %d\n", err);
	}

	printk("Next data publication in %d seconds\n",
	       CONFIG_PUBLICATION_INTERVAL_SECONDS);

	k_work_schedule(&shadow_update_work,
			K_SECONDS(CONFIG_PUBLICATION_INTERVAL_SECONDS));
}

static void shadow_update_version_work_fn(struct k_work *work)
{
	int err;

	err = shadow_update(true);
	if (err) {
		printk("shadow_update, error: %d\n", err);
	}
}

static int send_temp()
{
	printk("running send_temp \n");
	int err;
	float temperature=-300;
	float voltage=0.9;

	//read voltage
	voltage=read_voltage_sensor();

	//calc temp
	temperature=(voltage-0.5)*100;

	//put data in json object
	cJSON *root_obj = cJSON_CreateObject();
	//temperature=round(temperature);
	json_add_str(root_obj, "id", CONFIG_AWS_IOT_CLIENT_ID_STATIC);
	json_add_number(root_obj, "temperature", temperature);
	char *message;
	message=cJSON_Print(root_obj);

	//send data to aws
	if (message == NULL) {
		printk("cJSON_Print, error: returned NULL\n");
		err = -ENOMEM;
		goto cleanup;
	}
	struct aws_iot_data tx_data = {
		.qos = MQTT_QOS_0_AT_MOST_ONCE,
		.topic=generalNbTemperature,
		.ptr = message,
		.len = strlen(message)
	};


	printk("Publishing: %s to AWS IoT broker\n", message);

	err = aws_iot_send(&tx_data);
	if (err) {
		printk("aws_iot_send, error: %d\n", err);
	}

	cJSON_FreeString(message);

cleanup:

	cJSON_Delete(root_obj);

	return err;
}

/*
static bool checkKey(cJSON this_json, const char *searchedKey) 
{
    cJSON *name=cJSON_GetObjectItem(this_json, searchedKey);
    if (name)
	{
		return true;
	} else {
		return false;
	}
	
} */

static int nb_request_handler(const char *buf, const char *topic, size_t topic_len)
{
	char *str = NULL;
	const cJSON *root_obj = NULL;

	root_obj = cJSON_Parse(buf);
	if (root_obj == NULL) {
		printk("cJSON Parse failure");
		return 0;
	}

	str = cJSON_Print(root_obj);
	if (str == NULL) {
		printk("Failed to print JSON object, JSON object = null");
		goto clean_exit;
	}
	
	const cJSON *rec_action = NULL;
	const cJSON *rec_data = NULL;
	rec_action=cJSON_GetObjectItemCaseSensitive(root_obj, "action");
	if (!cJSON_IsNumber(rec_action))
	{
		printk("nothing \n");
		return 1;
	}
	if (rec_action->valuedouble==1)
	{
		printk("action 1 \n");
		send_temp();
	}
	else if (rec_action->valuedouble==2)
	{
		printk("action 2 \n");
		led_off();
	}
	else if (rec_action->valuedouble==3)
	{
		printk("action 3 \n");
		led_on();
	}
	else if (rec_action->valuedouble==4)
	{
		printk("action 4 \n");
		const cJSON *rec_day = NULL;
		const cJSON *rec_hour = NULL;
		rec_day=cJSON_GetObjectItemCaseSensitive(root_obj, "day");
		rec_hour=cJSON_GetObjectItemCaseSensitive(root_obj, "hour");
		if(cJSON_IsNumber(rec_day) && cJSON_IsNumber(rec_hour)){
			run_metering(rec_day->valueint, rec_hour->valueint);
		}
		else{
			printk("bad request \n");
		}
	}
	else if (rec_action->valuedouble==5)
	{
		printk("action 5 \n");
		ping_response();
	}
	else if (rec_action->valuedouble==6){
		run_metering_2();
	}
	else
	{
		printk("invalid action \n");
	}  
	

	cJSON_FreeString(str);

clean_exit:
	//cJSON_Delete(root_obj);
	return 1;
}

static void print_received_data(const char *buf, const char *topic, size_t topic_len)
{
	char *str = NULL;
	cJSON *root_obj = NULL;

	root_obj = cJSON_Parse(buf);
	if (root_obj == NULL) {
		printk("cJSON Parse failure");
		return;
	}

	str = cJSON_Print(root_obj);
	if (str == NULL) {
		printk("Failed to print JSON object");
		goto clean_exit;
	}

	printf("Data received from AWS IoT console:\nTopic: %.*s\nMessage: %s\n",
	       topic_len, topic, str);

	cJSON_FreeString(str);

clean_exit:
	cJSON_Delete(root_obj);
}

void aws_iot_event_handler(const struct aws_iot_evt *const evt)
{
	switch (evt->type) {
	case AWS_IOT_EVT_CONNECTING:
		printk("AWS_IOT_EVT_CONNECTING\n");
		break;
	case AWS_IOT_EVT_CONNECTED:
		printk("AWS_IOT_EVT_CONNECTED\n");

		cloud_connected = true;
		/* This may fail if the work item is already being processed,
		 * but in such case, the next time the work handler is executed,
		 * it will exit after checking the above flag and the work will
		 * not be scheduled again.
		 */
		(void)k_work_cancel_delayable(&connect_work);

		if (evt->data.persistent_session) {
			printk("Persistent session enabled\n");
		}

#if defined(CONFIG_NRF_MODEM_LIB)
		/** Successfully connected to AWS IoT broker, mark image as
		 *  working to avoid reverting to the former image upon reboot.
		 */
		boot_write_img_confirmed();
#endif

		/** Send version number to AWS IoT broker to verify that the
		 *  FOTA update worked.
		 */
		k_work_submit(&shadow_update_version_work);

		/** Start sequential shadow data updates.
		 */
		k_work_schedule(&shadow_update_work,
				K_SECONDS(CONFIG_PUBLICATION_INTERVAL_SECONDS));

#if defined(CONFIG_NRF_MODEM_LIB)
		int err = lte_lc_psm_req(true);
		if (err) {
			printk("Requesting PSM failed, error: %d\n", err);
		}
#endif
		break;
	case AWS_IOT_EVT_READY:
		printk("AWS_IOT_EVT_READY\n");
		break;
	case AWS_IOT_EVT_DISCONNECTED:
		printk("AWS_IOT_EVT_DISCONNECTED\n");
		cloud_connected = false;
		/* This may fail if the work item is already being processed,
		 * but in such case, the next time the work handler is executed,
		 * it will exit after checking the above flag and the work will
		 * not be scheduled again.
		 */
		(void)k_work_cancel_delayable(&shadow_update_work);
		k_work_schedule(&connect_work, K_NO_WAIT);
		break;
	case AWS_IOT_EVT_DATA_RECEIVED:
		printk("AWS_IOT_EVT_DATA_RECEIVED\n");
		print_received_data(evt->data.msg.ptr, evt->data.msg.topic.str, evt->data.msg.topic.len);
		if (1)
		{
			nb_request_handler(evt->data.msg.ptr, evt->data.msg.topic.str, evt->data.msg.topic.len);
			
		}
		break;
	case AWS_IOT_EVT_FOTA_START:
		printk("AWS_IOT_EVT_FOTA_START\n");
		break;
	case AWS_IOT_EVT_FOTA_ERASE_PENDING:
		printk("AWS_IOT_EVT_FOTA_ERASE_PENDING\n");
		printk("Disconnect LTE link or reboot\n");
#if defined(CONFIG_NRF_MODEM_LIB)
		err = lte_lc_offline();
		if (err) {
			printk("Error disconnecting from LTE\n");
		}
#endif
		break;
	case AWS_IOT_EVT_FOTA_ERASE_DONE:
		printk("AWS_FOTA_EVT_ERASE_DONE\n");
		printk("Reconnecting the LTE link");
#if defined(CONFIG_NRF_MODEM_LIB)
		err = lte_lc_connect();
		if (err) {
			printk("Error connecting to LTE\n");
		}
#endif
		break;
	case AWS_IOT_EVT_FOTA_DONE:
		printk("AWS_IOT_EVT_FOTA_DONE\n");
		printk("FOTA done, rebooting device\n");
		aws_iot_disconnect();
		sys_reboot(0);
		break;
	case AWS_IOT_EVT_FOTA_DL_PROGRESS:
		printk("AWS_IOT_EVT_FOTA_DL_PROGRESS, (%d%%)",
		       evt->data.fota_progress);
	case AWS_IOT_EVT_ERROR:
		printk("AWS_IOT_EVT_ERROR, %d\n", evt->data.err);
		break;
	case AWS_IOT_EVT_FOTA_ERROR:
		printk("AWS_IOT_EVT_FOTA_ERROR");
		break;
	default:
		printk("Unknown AWS IoT event type: %d\n", evt->type);
		break;
	}
}

static void work_init(void)
{
	k_work_init_delayable(&shadow_update_work, shadow_update_work_fn);
	k_work_init_delayable(&connect_work, connect_work_fn);
	k_work_init(&shadow_update_version_work, shadow_update_version_work_fn);
}

#if defined(CONFIG_NRF_MODEM_LIB)
static void lte_handler(const struct lte_lc_evt *const evt)
{
	switch (evt->type) {
	case LTE_LC_EVT_NW_REG_STATUS:
		if ((evt->nw_reg_status != LTE_LC_NW_REG_REGISTERED_HOME) &&
		     (evt->nw_reg_status != LTE_LC_NW_REG_REGISTERED_ROAMING)) {
			break;
		}

		printk("Network registration status: %s\n",
			evt->nw_reg_status == LTE_LC_NW_REG_REGISTERED_HOME ?
			"Connected - home network" : "Connected - roaming");

		k_sem_give(&lte_connected);
		break;
	case LTE_LC_EVT_PSM_UPDATE:
		printk("PSM parameter update: TAU: %d, Active time: %d\n",
			evt->psm_cfg.tau, evt->psm_cfg.active_time);
		break;
	case LTE_LC_EVT_EDRX_UPDATE: {
		char log_buf[60];
		ssize_t len;

		len = snprintf(log_buf, sizeof(log_buf),
			       "eDRX parameter update: eDRX: %f, PTW: %f",
			       evt->edrx_cfg.edrx, evt->edrx_cfg.ptw);
		if (len > 0) {
			printk("%s\n", log_buf);
		}
		break;
	}
	case LTE_LC_EVT_RRC_UPDATE:
		printk("RRC mode: %s\n",
			evt->rrc_mode == LTE_LC_RRC_MODE_CONNECTED ?
			"Connected" : "Idle");
		break;
	case LTE_LC_EVT_CELL_UPDATE:
		printk("LTE cell changed: Cell ID: %d, Tracking area: %d\n",
			evt->cell.id, evt->cell.tac);
		break;
	default:
		break;
	}
}

static void modem_configure(void)
{
	int err;

	if (IS_ENABLED(CONFIG_LTE_AUTO_INIT_AND_CONNECT)) {
		/* Do nothing, modem is already configured and LTE connected. */
	} else {
		err = lte_lc_init_and_connect_async(lte_handler);
		if (err) {
			printk("Modem could not be configured, error: %d\n",
				err);
			return;
		}
	}
}

static void nrf_modem_lib_dfu_handler(void)
{
	int err;

	err = nrf_modem_lib_get_init_ret();

	switch (err) {
	case MODEM_DFU_RESULT_OK:
		printk("Modem update suceeded, reboot\n");
		sys_reboot(SYS_REBOOT_COLD);
		break;
	case MODEM_DFU_RESULT_UUID_ERROR:
	case MODEM_DFU_RESULT_AUTH_ERROR:
		printk("Modem update failed, error: %d\n", err);
		printk("Modem will use old firmware\n");
		sys_reboot(SYS_REBOOT_COLD);
		break;
	case MODEM_DFU_RESULT_HARDWARE_ERROR:
	case MODEM_DFU_RESULT_INTERNAL_ERROR:
		printk("Modem update malfunction, error: %d, reboot\n", err);
		sys_reboot(SYS_REBOOT_COLD);
		break;
	default:
		break;
	}
}
#endif

static int app_topics_subscribe(void)
{
	int err;
	static char custom_topic[75] = "nb/request";
	static char custom_topic_2[75] = "my-custom-topic/example_2";

	const struct aws_iot_topic_data topics_list[APP_TOPICS_COUNT] = {
		[0].str = custom_topic,
		[0].len = strlen(custom_topic),
		[1].str = custom_topic_2,
		[1].len = strlen(custom_topic_2)
	};

	err = aws_iot_subscription_topics_add(topics_list,
					      ARRAY_SIZE(topics_list));
	if (err) {
		printk("aws_iot_subscription_topics_add, error: %d\n", err);
	}

	return err;
}

static void date_time_event_handler(const struct date_time_evt *evt)
{
	switch (evt->type) {
	case DATE_TIME_OBTAINED_MODEM:
		printk("DATE_TIME_OBTAINED_MODEM\n");
		break;
	case DATE_TIME_OBTAINED_NTP:
		printk("DATE_TIME_OBTAINED_NTP\n");
		break;
	case DATE_TIME_OBTAINED_EXT:
		printk("DATE_TIME_OBTAINED_EXT\n");
		break;
	case DATE_TIME_NOT_OBTAINED:
		printk("DATE_TIME_NOT_OBTAINED\n");
		break;
	default:
		break;
	}
}


void main(void)
{

	int err;

	printk("modified AWS IoT sample started, version: %s\n", CONFIG_APP_VERSION);

	cJSON_Init();

#if defined(CONFIG_NRF_MODEM_LIB)
	nrf_modem_lib_dfu_handler();
#endif

	err = aws_iot_init(NULL, aws_iot_event_handler);
	if (err) {
		printk("AWS IoT library could not be initialized, error: %d\n",
		       err);
	}

	/** Subscribe to customizable non-shadow specific topics
	 *  to AWS IoT backend.
	 */
	//publish_data();
	err = app_topics_subscribe();
	if (err) {
		printk("Adding application specific topics failed, error: %d\n",
			err);
	}

	work_init();
#if defined(CONFIG_NRF_MODEM_LIB)
	modem_configure();

	err = modem_info_init();
	if (err) {
		printk("Failed initializing modem info module, error: %d\n",
			err);
	}

	k_sem_take(&lte_connected, K_FOREVER);
#endif


	date_time_update_async(date_time_event_handler);
	k_work_schedule(&connect_work, K_NO_WAIT);
}
```

## src/certificates.h
```c
#define AWS_IOT_CLIENT_PRIVATE_KEY 
"-----BEGIN RSA PRIVATE KEY-----
MIIEogIBAAKCAQEA2VndpifoOa3wJNtngHJHMTJ19XXjYZ8r4Tx3DSMrHW5f/92Y
3E4J0G/X24NnPIS9lQV5sBVaSatqIbn+o6BeR4++aQJ0BCD7uuy95xhP6lW1wNFz
/vlGH1oCQgqBcgX2+XNlGILeIpavqyGtf753XktErSxcJU3oZRbqGeLf3QoMISGe
v2VE/T/2SxlFO1VR+8lRJ6lHX5H9+dORd4tUwFWn8GnqT/Lxa4ZFSiKa6EnLkKj5
PsXacsM8IGf5UNSiyxwGS71OD5ARlkcUtCD+zrynYK/bJDhRuIQa4r7/UGmHtlQC
M87mNWM5LPT5e4HrFU056USZ6H+ASTKLjcmSkwIDAQABAoIBAE9X0uX443lK2cNa
pKnrDboT5aO5aUwVwvryC7OsBu0zga/xwP+LLWH9shrcGS+qdVqVKRrycIc8H/43
25D31fLhsmy7DIcFU1+lVJ2r7mBo8XR2AZYugT6oqPJay25IZyQgz+Lmwxh1UaNz
I9biPMkbSPK+otSrYA6nEsZoX7hcagUScNzyBNFfgRTldIF/2Mzy26JYYh+dwZLw
Q/7/f1NoUOzrYM7+OQMCzpSYA+7pRUAffExFklFA9Dg8mVWaxq3yZkvwuGQOkSc9
QxJ/3xX0gy3XQU/HTEaL9Q6A8E+fJF7Aw+s2JP+fywr3cfG/dfoTFUsDTnUpkGHk
h90kqSECgYEA+5cDsDSxTdOA/lvkCL3clQchNB/j47k//4EEbTNmBINUdBN95A+O
YzfsSX9Elir3C33wNuhN/VDw/saufD8ELoxxZ9q1My1qIvI62/VtD2wBGYWw4lFo
psYsaQj8lIDYrf/xoVjnt5EST2QYH+PMa51gVLdE5P7xaK6ahxOee98CgYEA3Sk1
MgwmGaAXM0v52sir3LTXnhvjTZBSPPSot3iKhApqk/vHc+2fqk81+wdGtQKxV2gl
pLii8Bsm4vt3INmdIZYDpRf4hX7QvitcyyGLYmsgTGK9EM2VMwm1xzmzXRC3dUc2
/bm1knsA4yneYY/9Uq5QzWrrXCKyHXk9upUrv80Cf11crQG2jBVVZ4j8kKKt0i17
d9bf/rGDDTzDo+DiMfl6wtxQX2dCXpRzLDwZ/lm7l/GryniVvFtErindkOKKgALG
G09u2c8kCz7spOr7KH2QltfhxMI3c55v7AsOSqzRI5duYzx8wYBdVW4gttMetb05
qYXGfMp90RgHs1Bs92MCgYEAmyB5aKZu3xCU1W1YTybsrb3Hc+aZ1GED3i+6XB7Y
AfAQe8ZiS6WElgBDm9WpufOukuHBbb34xDQ3XYUHNWqOte00l0uuDW07W/iseOsJ
irobiJjFhxC8s3T/JUQK1J+SH1gZcXUesCVJJQ3MJ2DJToJouP1jI1hO2S+epc5W
Ro0CgYEAt6ufmdq5DJE5/us0XThnAbMf7PH4v81KLxGkX42dxlkfXQQsiuDzMr75
mWE/uY/7NV92zBaFObFgkFjTO0kF/gAo+uzT6Z8Oz1ANcj9BHUVGfKppL1uv61/3
LJWDcuSqyhs6OUiMjvIaMjiaPQ5HQRha7FDmuG2oHz3639TLnLA=
-----END RSA PRIVATE KEY-----"

#define AWS_IOT_CLIENT_PUBLIC_CERTIFICATE 
"-----BEGIN CERTIFICATE-----
MIIDWjCCAkKgAwIBAgIVAOZU78qjKQ9vPR5jCwNoER/eyTeYMA0GCSqGSIb3DQEB
CwUAME0xSzBJBgNVBAsMQkFtYXpvbiBXZWIgU2VydmljZXMgTz1BbWF6b24uY29t
IEluYy4gTD1TZWF0dGxlIFNUPVdhc2hpbmd0b24gQz1VUzAeFw0yMjAyMTAxNjQ4
NDVaFw00OTEyMzEyMzU5NTlaMB4xHDAaBgNVBAMME0FXUyBJb1QgQ2VydGlmaWNh
dGUwggEiMA0GCSqGSIb3DQEBAQUAA4IBDwAwggEKAoIBAQDZWd2mJ+g5rfAk22eA
ckcxMnX1deNhnyvhPHcNIysdbl//3ZjcTgnQb9fbg2c8hL2VBXmwFVpJq2ohuf6j
oF5Hj75pAnQEIPu67L3nGE/qVbXA0XP++UYfWgJCCoFyBfb5c2UYgt4ilq+rIa1/
vndeS0StLFwlTehlFuoZ4t/dCgwhIZ6/ZUT9P/ZLGUU7VVH7yVEnqUdfkf3505F3
i1TAVafwaepP8vFrhkVKIproScuQqPk+xdpywzwgZ/lQ1KLLHAZLvU4PkBGWRxS0
IP7OvKdgr9skOFG4hBrivv9QaYe2VAIzzuY1Yzks9Pl7gesVTTnpRJnof4BJMouN
yZKTAgMBAAGjYDBeMB8GA1UdIwQYMBaAFE4L+VBZ4Gk8FRzvlSGwhOdey0mjMB0G
A1UdDgQWBBSwx9TyUg9RVyGXkvtRiSJQ5TroRjAMBgNVHRMBAf8EAjAAMA4GA1Ud
DwEB/wQEAwIHgDANBgkqhkiG9w0BAQsFAAOCAQEAFuoZ3zRuvoqYlDyD60NSeAoE
8bkclVuWpXY20cRIcc/CDhrvIGiG1KiV4R7yVrFR7M/ICuilS8hDn+pliCtm30cJ
GGe4XKHCzRakcvZkAwH0LDzRT/VSTd+PEhGz213gHWcIzI3OZIAHk/AqZav0G2mH
nZuR06LCaHPKWX5gn5ZJk26tqgMpmDNAuHlqxGg0A1RMWAJ90aHfwQ4xZ0ZKYetK
B5QhRTIQAZK0tMJSaAu2QLXHdSlrKKuzCeKzKy4rbo57b3A+HL4/ZXbmhfM3QEi/
OzZHLw5CLkD0J65qU/nYAIm8S5R2u7V9GiS+BIXR67DtNjh5BDimPFKoU23mBw==
-----END CERTIFICATE-----"

#define AWS_IOT_CA_CERTIFICATE 
"-----BEGIN CERTIFICATE-----
MIIDQTCCAimgAwIBAgITBmyfz5m/jAo54vB4ikPmljZbyjANBgkqhkiG9w0BAQsF
ADA5MQswCQYDVQQGEwJVUzEPMA0GA1UEChMGQW1hem9uMRkwFwYDVQQDExBBbWF6
b24gUm9vdCBDQSAxMB4XDTE1MDUyNjAwMDAwMFoXDTM4MDExNzAwMDAwMFowOTEL
MAkGA1UEBhMCVVMxDzANBgNVBAoTBkFtYXpvbjEZMBcGA1UEAxMQQW1hem9uIFJv
b3QgQ0EgMTCCASIwDQYJKoZIhvcNAQEBBQADggEPADCCAQoCggEBALJ4gHHKeNXj
ca9HgFB0fW7Y14h29Jlo91ghYPl0hAEvrAIthtOgQ3pOsqTQNroBvo3bSMgHFzZM
9O6II8c+6zf1tRn4SWiw3te5djgdYZ6k/oI2peVKVuRF4fn9tBb6dNqcmzU5L/qw
IFAGbHrQgLKm+a/sRxmPUDgH3KKHOVj4utWp+UhnMJbulHheb4mjUcAwhmahRWa6
VOujw5H5SNz/0egwLX0tdHA114gk957EWW67c4cX8jJGKLhD+rcdqsq08p8kDi1L
93FcXmn/6pUCyziKrlA4b9v7LWIbxcceVOF34GfID5yHI9Y/QCB/IIDEgEw+OyQm
jgSubJrIqg0CAwEAAaNCMEAwDwYDVR0TAQH/BAUwAwEB/zAOBgNVHQ8BAf8EBAMC
AYYwHQYDVR0OBBYEFIQYzIU07LwMlJQuCFmcx7IQTgoIMA0GCSqGSIb3DQEBCwUA
A4IBAQCY8jdaQZChGsV2USggNiMOruYou6r4lK5IpDB/G/wkjUu0yKGX9rbxenDI
U5PMCCjjmCXPI6T53iHTfIUJrU6adTrCC2qJeHZERxhlbI1Bjjt/msv0tadQ1wUs
N+gDS63pYaACbvXy8MWy7Vu33PqUXHeeE6V/Uq2V8viTO96LXFvKWlJbYK8U90vv
o/ufQJVtMVT8QtPHRh8jrdkPSHCa2XV4cdFyQzR1bldZwgJcJmApzyMZFo6IQ6XU
5MsI+yMRQ+hDKXJioaldXgjUkK642M4UwtBV8ob2xJNDd2ZhwLnoQdeXeGADbkpy
rqXRfboQnoZsG4q5WTP468SQvvG5
-----END CERTIFICATE-----"
```
